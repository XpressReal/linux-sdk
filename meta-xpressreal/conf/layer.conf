## meta-xpressreal/recipes-bsp/u-boot/files/src/configs/rtd1625_phantom_defconfig
```kconfig
CONFIG_ARM=y
CONFIG_SKIP_LOWLEVEL_INIT=y
CONFIG_ARM_SMCCC=y
CONFIG_ARCH_REALTEK=y
CONFIG_BOARD_FIT_CONFIG_NAME="rtd1501s-phantom"
CONFIG_TEXT_BASE=0x03F60000
CONFIG_SYS_MALLOC_LEN=0xE00000
CONFIG_SYS_MALLOC_F_LEN=0xE00000
# CONFIG_SYS_MALLOC_CLEAR_ON_INIT is not set
CONFIG_LOCALVERSION="-kent"
CONFIG_SPL_GPIO=y
CONFIG_NR_DRAM_BANKS=6
CONFIG_ENV_OFFSET=0
CONFIG_ENV_OFFSET_REDUND=0x10000
CONFIG_ENV_SECT_SIZE=0x1000
CONFIG_ENV_SECT_SIZE_AUTO=y
CONFIG_ENV_IS_NOWHERE=y
CONFIG_ENV_IS_IN_SPI_FLASH=y
CONFIG_ENV_IS_IN_MMC=y
CONFIG_ENV_SIZE=0x10000
CONFIG_SYS_MMC_ENV_DEV=0
CONFIG_SYS_MMC_ENV_PART=1
CONFIG_ENV_MMC_USE_DT=y
CONFIG_SYS_REDUNDAND_ENVIRONMENT=y
CONFIG_SYS_RELOC_GD_ENV_ADDR=y
CONFIG_SPL_DM_SPI=y
CONFIG_USE_DEFAULT_ENV_FILE=y
CONFIG_DEFAULT_ENV_FILE="board/realtek/rtd1625_emmc.env"
CONFIG_DEFAULT_DEVICE_TREE="rtd1501s-phantom"
CONFIG_SYS_BOOTM_LEN=0x01E00000
CONFIG_SPL_TEXT_BASE=0x03F00000
CONFIG_SPL_MAX_FOOTPRINT=0x00060000
CONFIG_SPL_MAX_SIZE=0x257E0
CONFIG_SPL_PAD_TO=0x257E0
CONFIG_SPL_BSS_MAX_SIZE=0x4000
CONFIG_SPL_SYS_MALLOC=y
CONFIG_SPL_HAS_CUSTOM_MALLOC_START=y
CONFIG_SPL_CUSTOM_SYS_MALLOC_ADDR=0x07880000
CONFIG_SPL_SYS_MALLOC_SIZE=0xE00000
# CONFIG_SPL_SEPARATE_BSS is not set
CONFIG_TARGET_RTD1625=y
CONFIG_USB_BOOT_GPIO_NUM=0
CONFIG_RTK_MMC_DRIVER=y
CONFIG_SPL_MMC=y
CONFIG_SPL_SERIAL=y
CONFIG_SPL=y
CONFIG_SPL_FS_FAT=y
CONFIG_SPL_FS_LOAD_PAYLOAD_NAME="u-boot.bin-rtd1625_emmc"
CONFIG_SPL_SPI_FLASH_SUPPORT=y
CONFIG_SPL_SPI=y
# CONFIG_PSCI_RESET is not set
CONFIG_BUILD_TARGET="u-boot.itb"
CONFIG_SYS_CUSTOM_LDSCRIPT=y
CONFIG_SYS_LDSCRIPT="arch/arm/mach-realtek/u-boot.lds"
CONFIG_SYS_LOAD_ADDR=0x20000000
# CONFIG_ANDROID_BOOT_IMAGE is not set
CONFIG_HAS_CUSTOM_SYS_INIT_SP_ADDR=y
CONFIG_CUSTOM_SYS_INIT_SP_ADDR=0x14000000
CONFIG_FIT_VERBOSE=y
CONFIG_FIT_CIPHER=y
CONFIG_FIT_SIGNATURE=y
CONFIG_SPL_LOAD_FIT=y
CONFIG_SPL_LOAD_FIT_APPLY_OVERLAY=y
CONFIG_SPL_FIT_CIPHER=y
CONFIG_SPL_FIT_SIGNATURE=y
CONFIG_SPL_FIT_SOURCE="board/realtek/rtd1625_emmc.its"
# CONFIG_USE_SPL_FIT_GENERATOR is not set
# CONFIG_BOOTMETH_EXTLINUX is not set
# CONFIG_BOOTMETH_VBE is not set
CONFIG_OF_BOARD=y
CONFIG_OF_BOARD_SETUP=y
CONFIG_OF_STDOUT_VIA_ALIAS=y
# CONFIG_BOOTSTD is not set
CONFIG_BOOTDELAY=0
CONFIG_USE_BOOTCOMMAND=y
CONFIG_SYS_CONSOLE_IS_IN_ENV=y
CONFIG_MISC_INIT_R=y
CONFIG_SPL_BOARD_INIT=y
CONFIG_SPL_DM_SPI_FLASH=y
# CONFIG_SPL_RAW_IMAGE_SUPPORT is not set
CONFIG_SPL_SYS_MALLOC_SIMPLE=y
# CONFIG_SPL_SPI_FLASH_TINY is not set
CONFIG_SPL_SPI_LOAD=y
CONFIG_SYS_SPI_U_BOOT_OFFS=0x100000
CONFIG_SYS_MMCSD_RAW_MODE_U_BOOT_USE_SECTOR=y
CONFIG_SYS_MMCSD_RAW_MODE_U_BOOT_SECTOR=0x7b5
CONFIG_SYS_MMCSD_FS_BOOT_PARTITION=1
CONFIG_SPL_USB_HOST=y
CONFIG_SPL_USB_STORAGE=y
CONFIG_HUSH_PARSER=y
CONFIG_SYS_PROMPT="Realtek> "
CONFIG_SYS_CBSIZE=640
CONFIG_SYS_PBSIZE=665
# CONFIG_CMD_CONSOLE is not set
# CONFIG_CMD_BOOTD is not set
# CONFIG_BOOTM_VXWORKS is not set
# CONFIG_CMD_IMI is not set
# CONFIG_CMD_XIMG is not set
# CONFIG_CMD_EXPORTENV is not set
# CONFIG_CMD_IMPORTENV is not set
# CONFIG_CMD_CRC32 is not set
CONFIG_CMD_GPT=y
# CONFIG_CMD_LOADS is not set
CONFIG_CMD_MBR=y
CONFIG_CMD_MMC=y
CONFIG_CMD_MTD=y
CONFIG_CMD_PART=y
CONFIG_CMD_READ=y
CONFIG_CMD_USB=y
# CONFIG_CMD_RTK_PMIC is not set
# CONFIG_CMD_ECHO is not set
CONFIG_CMD_TFTPPUT=y
# CONFIG_CMD_NFS is not set
CONFIG_CMD_PING=y
CONFIG_CMD_CACHE=y
CONFIG_CMD_GETTIME=y
CONFIG_CMD_EXT2=y
CONFIG_CMD_FAT=y
CONFIG_CMD_FS_GENERIC=y
CONFIG_CMD_HASH=y
CONFIG_CMD_MTDPARTS=y
CONFIG_MTDIDS_DEFAULT="nor0=RtkSFC"
CONFIG_MTDPARTS_DEFAULT="mtdparts=RtkSFC:1024k(bootcode)ro,640k@0x100000(u-boot)"
CONFIG_OF_CONTROL=y
CONFIG_OF_OVERLAY_LIST="cipher tee"
CONFIG_SPL_OF_CONTROL=y
CONFIG_SPL_MULTI_DTB_FIT=y
CONFIG_OF_LIVE=y
CONFIG_ENV_OVERWRITE=y
CONFIG_TFTP_BLOCKSIZE=400
CONFIG_SUPPORT_EMMC_BOOT=y
CONFIG_DM=y
CONFIG_SPL_DM=y
CONFIG_REGMAP=y
CONFIG_SPL_REGMAP=y
CONFIG_SPL_OF_TRANSLATE=y
# CONFIG_BLK is not set
CONFIG_USB_FUNCTION_FASTBOOT=y
CONFIG_FASTBOOT_BUF_ADDR=0x20000000
CONFIG_FASTBOOT_BUF_SIZE=0x06400000
CONFIG_MISC=y
CONFIG_MTD=y
CONFIG_DM_SPI_FLASH=y
CONFIG_SPI_RTK_SFC=y
CONFIG_SPI_FLASH_GIGADEVICE=y
CONFIG_SPI_FLASH_MTD=y
# CONFIG_SPI_FLASH_USE_4K_SECTORS is not set
CONFIG_PHY_RTK_RTD_USB2PHY=y
CONFIG_PHY_RTK_RTD_USB3PHY=y
CONFIG_BAUDRATE=460800
CONFIG_SYS_NS16550=y
CONFIG_SYS_NS16550_SERIAL=y
CONFIG_SYS_NS16550_REG_SIZE=-4
CONFIG_SPI=y
CONFIG_USB=y
CONFIG_DM_SPI=y
CONFIG_DM_USB_GADGET=y
CONFIG_USB_XHCI_HCD=y
CONFIG_USB_DWC3=y
CONFIG_USB_DWC3_GENERIC=y
CONFIG_USB_STORAGE=y
CONFIG_USB_GADGET=y
CONFIG_USB_GADGET_MANUFACTURER="Realtek U-Boot"
CONFIG_USB_GADGET_VENDOR_NUM=0x18d1
CONFIG_USB_GADGET_PRODUCT_NUM=0x4e40
CONFIG_USB_FUNCTION_MASS_STORAGE=y
CONFIG_USB_MAX_CONTROLLER_COUNT=4
CONFIG_FAT_WRITE=y
# CONFIG_SPL_SHA1 is not set
CONFIG_LZO=y
CONFIG_MMC_HS200_SUPPORT=y
#CONFIG_SPL_MMC_HS200_SUPPORT=y
CONFIG_OPTEE_LIB=y
# CONFIG_EFI_LOADER is not set

# For U-Boot script support
#CONFIG_LEGACY_IMAGE_FORMAT=y
```

## meta-xpressreal/recipes-kernel/linux/files-5.10/avengers-kmeta/bsp/drivers/soc/realtek/runtime_device/Kconfig
```kconfig
config RUNTIME_DEVICE_SELECTOR
	tristate "Runtime device selector Driver"
	depends on I2C
	depends on OF
	help
	  This driver would probe devices base on runtime results.

	  If not sure, say N.

config REGULATOR_SUPPLY_ALIAS
	tristate "Regulator supply alias Driver"
	depends on OF
	depends on REGULATOR
	default n
	help
	  This driver provdes a simple approach for supporting dynamic
	  selection to regulator devices.

	  If not sure, say N.
```

## meta-xpressreal/recipes-kernel/linux/files-6.12/avengers-kmeta/bsp/drivers/media/platform/rtk-vi/Kconfig
```kconfig
# SPDX-License-Identifier: GPL-2.0-only

comment "Realtek Video input driver"

config RTK_VI
	tristate "RTK VI Support"
	select VIDEOBUF2_DMA_CONTIG
help
	This is a v4l2 driver for Realtek video input interface.
```

## meta-xpressreal/recipes-kernel/linux/files-6.12/avengers-kmeta/bsp/drivers/soc/realtek/common/aut/Kconfig
```kconfig
config RTK_AUT_CONTROL
	tristate "Realtek Automotive Control driver"
	default y
	help
	  This enables Realtek Automotive-Control interface.

config RTK_AUT_RCAM
	tristate "Realtek Automotive Rear Camera Interface"
	default n
	help
	  This enables Realtek Automotive rear-camer interface
	  for platforms w/o cluster.
```

## meta-xpressreal/recipes-kernel/linux/files-6.12/avengers-kmeta/bsp/drivers/soc/realtek/gpu/Kconfig
```kconfig
config RTK_GPU_WRAP
	tristate "Realtek GPU Wrapper Driver"
	depends on ARCH_REALTEK
	default y
	help
	  This enable Realtek GPU Wrapper Driver.

config RTK_GPU_CACHE
	tristate "Realtek GPU Cache Driver"
	depends on ARCH_REALTEK
	depends on RTK_GPU_WRAP
	default n
	help
	  This enable Realtek GPU Caceh Driver for providing control of
	  gpu cache.

config RTK_GPU_CACHE_CONTROL
	bool "Realtek GPU Cache Kernel API"
	depends on RTK_GPU_CACHE
	default n
	help
	  This enable GPU Cache Kernel API
```

## meta-xpressreal/recipes-kernel/linux/files-6.6/avengers-kmeta/bsp/Documentation/devicetree/bindings/soc/realtek/autoread.txt
```
Realtek Autoread dt-bindings
=====================================

Required properties:
- compatible: "realtek,autoread"
- reg: address range of autoread
- ina_type: specifies the INA device type used. For example, use <226> for ina226, <231> for ina231

Example:

soc {
	autoread: autoread@c00 {
		compatible = "realtek,autoread";
		reg = <0xc00 0x100>;
		ina_type = <231>;
	};
};
```

## meta-xpressreal/recipes-kernel/linux/files-6.6/avengers-kmeta/bsp/drivers/media/platform/rtk-mipi-csi/Kconfig
```kconfig
# SPDX-License-Identifier: GPL-2.0-only

comment "Realtek MIPI CSI driver"

config RTK_MIPI_CSI
	tristate "RTK MIPI CSI Support"
	select VIDEOBUF2_DMA_CONTIG
help
	This is a v4l2 driver for Realtek MIPI CSI interface.
```

## meta-xpressreal/recipes-kernel/linux/files-6.6/avengers-kmeta/bsp/drivers/media/platform/rtk_npp/Kconfig
```kconfig
# SPDX-License-Identifier: GPL-2.0-only

comment "Realtek NPU_NPP driver"

config RTK_NPP
        tristate "RTK NPP Support"
        depends on VIDEO_DEV
        depends on HAS_DMA
        select VIDEOBUF2_DMA_CONTIG
        select VIDEOBUF2_VMALLOC
        select V4L2_CAPTURE_DEV
        select V4L2_MEM2MEM_DEV
	default n
	help
		This option enables support for the Realtek NPU (Neural Processing Unit)
		NPP (Neural Processing Pipeline) V4L2 (Video for Linux) driver.
		The RTK NPP driver provides capabilities for video processing using Realtek's
		NPU, which is particularly useful for applications requiring hardware-accelerated
		video encoding, decoding, and other video processing tasks.
		This driver depends on the V4L2 framework and requires DMA (Direct Memory Access)
		capabilities. It also selects necessary components like VIDEOBUF2_DMA_CONTIG for
		contiguous DMA buffers and V4L2_CAPTURE_DEV for capture video device support or
		V4L2_MEM2MEM_DEV for memory-to-memory video device support .
		If you are developing or using applications that need to leverage Realtek's NPU for
		video processing, say Y or M here. Otherwise, it is safe to say N.
```

## meta-xpressreal/recipes-kernel/linux/files-6.6/avengers-kmeta/bsp/drivers/media/platform/rtk_vdec/Kconfig
```kconfig
#Copyright (C) 2017 Realtek Semiconductor Corporation

config RTK_V4L2_DECODER
	bool "Realtek V4L2 Decoder Interface"
	depends on VIDEO_DEV
	select VIDEOBUF2_DMA_CONTIG
	select VIDEOBUF2_VMALLOC
	select V4L2_MEM2MEM_DEV
	default n
	help
		Realtek V4L2 Decoder Driver Interface

config RTK_VDEC
	tristate "V4L2 Decoder Codec Driver"
	depends on RTK_V4L2_DECODER
	default n
	help
		Realtek V4L2 Codec Driver
```

## meta-xpressreal/recipes-kernel/linux/files-6.6/avengers-kmeta/bsp/drivers/soc/realtek/cpudvfs/Kconfig
```kconfig
menu "Realtek CPU DVFS Related Drivers"

config RTK_CPU_VOLT_SEL
	tristate "Add OPP prop extn to CPU device"
	depends on PM_OPP
	default y
	help
	  This helps to set OPP prop extn to CPU devices based on additional
	  information for Realtek platform. If not sure, say Y.

config RTK_FSS_SCAN
	tristate "Realtek FSS Scan Driver"
	depends on RTK_FSS
	default n
	help
	  This driver provides control to run fss scan in userspace.
	  a CPU frequency/voltage pair would be set, and the driver would check
	  speed paraments from fss sensor and determine the voltage is suitable
	  to be used or not. If not sure, say N.

config RTK_REGULATOR_COUPLER
	bool "Realtek Regulator Coupler"
	default n
	help
	  This enables Realtek Regulator Coupler for CPU & CPUSRAM

endmenu
```

## meta-xpressreal/recipes-kernel/linux/files-6.6/avengers-kmeta/bsp/sound/soc/realtek/Kconfig
```kconfig
config SND_ACPU_AO
	tristate "Realtek AO in ACPU"
	depends on SND_SOC_REALTEK
	select RTK_REFCLK
	default n

config SND_HIFI_AO
	tristate "Realtek AO in HIFI"
	depends on SND_SOC_REALTEK
	select RTK_REFCLK
	default n

config RTK_CACHEABLE_HEADER
	bool "HIFI with cacheable header"
	depends on SND_HIFI_AO
	default n
	help
	  Enable cacheable HIFI header.

config SND_SOC_REALTEK
	tristate "Realtek ALSA Driver"
	select SND_HWDEP
	select SND_RAWMIDI
	select SND_PCM
	select SND_SOC_COMPRESS
	default n

config SND_HIFI_RTK_COMPRESS
	tristate "RTK ALSA Compress Driver"
	depends on SND_HIFI_AO
	default n

config SND_SOC_REALTEK_NOTIFY
	tristate "Realtek ALSA Notfiy Driver"
	depends on SND_SOC_REALTEK
	default n

config SND_SOC_REALTEK_FL3236
	tristate "REALTEK Feature for fl3236 light driver"
	default n

config SND_SOC_RTK_HIFI_MACHINE
	tristate "Realtek hifi asoc machine Driver"
	select SND_SOC_RT5645
	default n
```
