## meta-xpressreal/conf/layer.conf
```bitbake
# We have a conf and classes directory, add to BBPATH
BBPATH .= ":${LAYERDIR}"

# We have recipes-* directories, add to BBFILES
BBFILES += "${LAYERDIR}/recipes-*/*/*.bb \
            ${LAYERDIR}/recipes-*/*/*.bbappend"

BBFILE_COLLECTIONS += "avengers"
BBFILE_PATTERN_avengers = "^${LAYERDIR}/"
BBFILE_PRIORITY_avengers = "6"

LAYERDEPENDS_avengers = "core"
LAYERSERIES_COMPAT_avengers = "scarthgap"
```

## meta-xpressreal/conf/machine/backinblack-rtd1619b.conf
```bitbake
#@TYPE: Machine
#@NAME: Realtek Stark based BackinBlack EVM board
#@DESCRIPTION: Machine configuration for the RTD1619b BackinBlack board

MACHINE_FEATURES := "drm mali v4l2"
MACHINE_FEATURES += "npu"
MACHINE_FEATURES += "bt"

include conf/machine/include/stark.inc

UBOOT_CONFIG = "rtd1619b_emmc"
UBOOT_CONFIG[rtd1619b_emmc] = "rtd1619b_backinblack_defconfig,,u-boot.itb"
IMAGE_BOOT_FILES:remove = "u-boot.bin-rtd1619b_spi"
```

## meta-xpressreal/conf/machine/include/hank.inc
```bitbake
# add a common override for all rtd1319 based board

MACHINEOVERRIDES =. "hank:"

require conf/machine/include/arm/armv8-2a/tune-cortexa55.inc
require conf/machine/include/avengers.inc

SPL_SUFFIX = "bin_pad"
SPL_BINARY = "spl/u-boot-spl.bin_pad"

#UBOOT_MACHINE = "rtd1319_spi_defconfig"
UBOOT_CONFIG ??= "rtd1319_spi"
UBOOT_CONFIG[rtd1319_spi] = "rtd1319_spi_defconfig,,u-boot.img"

IMAGE_BOOT_FILES += " \
	u-boot.bin-rtd1319_spi \
	"

KERNEL_DEVICETREE:append = " realtek/rtd1319-pymparticles-2gb-spi.dtb"
```

## meta-xpressreal/conf/machine/include/kent.inc
```bitbake
# add a common override for all rtd1625 based board

MACHINEOVERRIDES =. "kent:"

require conf/machine/include/arm/armv8-2a/tune-cortexa78.inc
require conf/machine/include/avengers.inc
require conf/machine/include/overlayfs.inc

SPL_SUFFIX = "bin_pad"
SPL_BINARY = "spl/u-boot-spl.bin_pad"

#UBOOT_MACHINE = "rtd1625_emmc_defconfig"
UBOOT_CONFIG ??= "rtd1625_emmc"
UBOOT_CONFIG[rtd1625_emmc] = "rtd1625_phantom_defconfig,,u-boot.itb"

IMAGE_BOOT_FILES += " \
	u-boot.bin-rtd1625_emmc \
	"
IMAGE_BOOT_FILES:append = " ${@bb.utils.contains('MACHINE_FEATURES', 'SPL', 'rtd1625_emmc_bind.bin', '', d)}"

KERNEL_DEVICETREE = " \
	realtek/rtd1501s-phantom-8gb.dtb \
	realtek/rtd1501-rescue.dtb \
	"
IMAGE_INSTALL:append = " ${@bb.utils.contains('MACHINE_FEATURES', 'drm', 'linux-firmware-rtd1625', '', d)}"

IMAGE_INSTALL:append = " ${@bb.utils.contains('MACHINE_FEATURES', 'npu', 'libnpu', '', d)}"
IMAGE_INSTALL:append = " ${@bb.utils.contains('MACHINE_FEATURES', 'npu', 'rtk-mod-npu', '', d)}"
IMAGE_INSTALL:append = " ${@bb.utils.contains('MACHINE_FEATURES', 'npu', 'npu-header-dev', '', d)}"
IMAGE_INSTALL:append = " ${@bb.utils.contains('MACHINE_FEATURES', 'npu', 'fr-demo', '', d)}"
IMAGE_INSTALL:append = " ${@bb.utils.contains('MACHINE_FEATURES', 'npu', 'od-demo', '', d)}"
IMAGE_INSTALL:append = " ${@bb.utils.contains('MACHINE_FEATURES', 'npu', 'pose-demo', '', d)}"
```

## meta-xpressreal/conf/machine/include/overlayfs.inc
```bitbake
# meta-avengers overlayfs default settings

OVERLAYFS_ETC_MOUNT_POINT ?= "/overlay"
OVERLAYFS_ETC_FSTYPE ?= "ext4"
# Prefer SDMMC to eMMC
OVERLAYFS_ETC_DEVICE ?= "/dev/mmcblk1p3 /dev/mmcblk0p3"
OVERLAYFS_ETC_USE_ORIG_INIT_NAME ?= "0"
OVERLAYFS_ETC_MOUNT_OPTIONS ?= "defaults"
OVERLAYFS_ETC_INIT_TEMPLATE ?= "${COREBASE}/meta/files/overlayfs-root-preinit.sh.in"
OVERLAYFS_ETC_EXPOSE_LOWER ?= "0"
OVERLAYFS_ETC_CREATE_MOUNT_DIRS ?= "0"
```

## meta-xpressreal/conf/machine/include/rootfs.inc
```bitbake
# add a common rootfs override for prebuilt rootfs, such as Debian/Ubuntu
# Please use OVERRIDES to set ubuntu in your local.conf, default is debian
# OVERRIDES:append = ":ubuntu"
# Use OVERRIDES:append = ":rpios" to use RPIOS rootfs
#
# Debian rootfs image:
# -- debian-rootfs.tar.xz => console mode based rootfs
#    can be combined with MACHINE set to "bleedingedge-rtd1619b-mini"
#    can append "drm" in MACHINE_FEATURES to get virtual console support
# -- desktop-debian-rootfs.tar.xz => XFCE based Debian rootfs tar ball
# -- weston-debian-rootfs.tar.xz => Weston based Debian rootfs tar ball
#
# Ubuntu rootfs image:
# -- ubuntu-rootfs.tar.xz => console mode based rootfs
#    can be combined with MACHINE set to "bleedingedge-rtd1619b-mini"
#    can append "drm" in MACHINE_FEATURES to get virtual console support
# -- desktop-ubuntu-rootfs.tar.xz => Ubuntu Desktop rootfs image
# -- weston-ubuntu-rootfs.tar.xz => Weston based Ubuntu rootfs tar ball
#
# RPIOS rootfs image:
# -- rpios-rootfs.tar.xz => console mode based rootfs
#    can be combined with MACHINE set to "bleedingedge-rtd1619b-mini"
#    can append "drm" in MACHINE_FEATURES to get virtual console support
# -- desktop-rpios-rootfs.tar.xz => Ubuntu Desktop rootfs image
# !!!! No support for weston-rpios-rootfs.tar.xz !!!!!
#
# MACHINE_FEATURES:append = " xdesktop"
# select full desktop environment in Debian, Ubuntu or RPIOS
#
# MACHINE_FEATURES:
# split-home conflicts with overlayfs-root

#debian/ubuntu related settings
PREBUILT_NAME = "debian-rootfs.tar.xz"
PREBUILT_NAME:ubuntu = "ubuntu-rootfs.tar.xz"
PREBUILT_NAME:rpios = "rpios-rootfs.tar.xz"

python() {
    features = d.getVar("MACHINE_FEATURES").split()
    name = d.getVar("PREBUILT_NAME")

    if "mali" not in features and "panfrost" in features:
        features.remove("panfrost")
        if "xdesktop" in features:
            features.remove("xdesktop")
        d.setVar("MACHINE_FEATURES", " ".join(features))

    if "xdesktop" in features and "panfrost" in features:
        d.setVar("PREBUILT_NAME", "desktop-" + name)
    elif "mali" in features:
        d.setVar("PREBUILT_NAME", "weston-" + name)

    if "overlayfs-root" in features and "split-home" in features:
        raise bb.parse.SkipRecipe("Could not set both overlayfs-root and split-home in MACHINE_FEATURES!")
}
```

## meta-xpressreal/conf/machine/include/stark.inc
```bitbake
# add a common override for all rtd1619b based board

MACHINEOVERRIDES =. "stark:"

require conf/machine/include/arm/armv8-2a/tune-cortexa55.inc
require conf/machine/include/avengers.inc
require conf/machine/include/overlayfs.inc

SPL_SUFFIX = "bin_pad"
SPL_BINARY = "spl/u-boot-spl.bin_pad"

#UBOOT_MACHINE = "rtd1619b_emmc_defconfig"
UBOOT_CONFIG ??= "rtd1619b_emmc rtd1619b_spi"
UBOOT_CONFIG[rtd1619b_emmc] = "rtd1619b_bleedingedge_defconfig,,u-boot.itb"
UBOOT_CONFIG[rtd1619b_spi] = "rtd1619b_spi_defconfig,,u-boot.itb"

IMAGE_BOOT_FILES += " \
	u-boot.bin-rtd1619b_emmc \
	u-boot.bin-rtd1619b_spi \
	"
IMAGE_BOOT_FILES:append = " ${@bb.utils.contains('MACHINE_FEATURES', 'SPL', 'rtd1619b_emmc_bind.bin rtd1619b_emmc_bind_4gb.bin', '', d)}"

KERNEL_DEVICETREE = " \
	realtek/rtd1619b-bleedingedge-2gb.dtb \
	realtek/rtd1619b-backinblack-2gb.dtb \
	realtek/rtd1315c-badassium-2gb.dtb \
	realtek/rtd1619b-rescue.dtb \
	"
KERNEL_DEVICETREE:append = " realtek/rtd1619b-bleedingedge-2gb-spi.dtb"
IMAGE_INSTALL:append = " ${@bb.utils.contains('MACHINE_FEATURES', 'drm', 'linux-firmware-rtd1619b', '', d)}"
IMAGE_INSTALL:append = " ${@bb.utils.contains('MACHINE_FEATURES', 'npu', 'libnpu', '', d)}"
IMAGE_INSTALL:append = " ${@bb.utils.contains('MACHINE_FEATURES', 'npu', 'rtk-mod-npu', '', d)}"
IMAGE_INSTALL:append = " ${@bb.utils.contains('MACHINE_FEATURES', 'npu', 'npu-header-dev', '', d)}"
IMAGE_INSTALL:append = " ${@bb.utils.contains('MACHINE_FEATURES', 'npu', 'fr-demo', '', d)}"
IMAGE_INSTALL:append = " ${@bb.utils.contains('MACHINE_FEATURES', 'npu', 'od-demo', '', d)}"
IMAGE_INSTALL:append = " ${@bb.utils.contains('MACHINE_FEATURES', 'npu', 'pose-demo', '', d)}"
IMAGE_INSTALL:append = " ${@bb.utils.contains('MACHINE_FEATURES', 'tee', 'linux-tee', '', d)}"
```

## meta-xpressreal/conf/machine/pymparticles-rtd1319-mini.conf
```bitbake
#@TYPE: Machine
#@NAME: Realtek Hank based Pymparticles EVM board
#@DESCRIPTION: Machine configuration for the RTD1319 Pymparticles board for console only applications

include conf/machine/include/hank.inc
include conf/machine/include/nogui.inc

KERNEL_DEVICETREE = " \
	realtek/rtd1319-pymparticles-2gb.dtb \
	realtek/rtd1319-rescue.dtb \
	"
```

## meta-xpressreal/conf/machine/realtekevb-rtd1619b.conf
```bitbake
#@TYPE: Machine
#@NAME: Realtek Stark based EVM board
#@DESCRIPTION: Machine configuration for the RTD1619b board

MACHINE_FEATURES := "drm mali v4l2"
MACHINE_FEATURES += "npu"
MACHINE_FEATURES += "bt"

include conf/machine/include/stark.inc

UBOOT_CONFIG[rtd1619b_emmc] = "rtd1619b_emmc_defconfig,,u-boot.itb"
IMAGE_BOOT_FILES:remove = "rtd1619b_emmc_bind_4gb.bin"
```

## meta-xpressreal/conf/machine/xpressreal-rtd1619b.conf
```bitbake
#@TYPE: Machine
#@NAME: Realtek Stark based XpressReal EVM board
#@DESCRIPTION: Machine configuration for the RTD1619b XpressReal board

MACHINE_FEATURES := "drm mali v4l2"
MACHINE_FEATURES += "npu"
MACHINE_FEATURES += "bt"

include conf/machine/include/stark.inc

# No bootcode area auto upgrade
MACHINE_FEATURES:remove = "SPL"

KERNEL_DEVICETREE = " \
	realtek/rtd1619b-xpressreal-2gb.dtb \
	realtek/rtd1619b-rescue-xpressreal.dtb \
	"

UBOOT_CONFIG = "rtd1619b_emmc"
UBOOT_CONFIG[rtd1619b_emmc] = "rtd1619b_xpressreal_defconfig,,u-boot.itb"
IMAGE_BOOT_FILES:remove = "u-boot.bin-rtd1619b_spi"
```

## meta-xpressreal/recipes-bsp/bootfiles/files/image-rtd1619b-xpressreal.its
```
/dts-v1/;

/ {
    description = "U-Boot fitImage for rtd1619b aarch64 kernel";
    #address-cells = <1>;

    images {
        kernel-1 {
            description = "Linux Kernel";
            data = /incbin/("./kernel.lzo");
            type = "kernel";
            arch = "arm64";
            os = "linux";
            compression = "lzo";
            load = <0x01200000>; /* ALIGN(0x01008000, SZ_2M); */
            entry = <0x01200000>;
            hash-1 {
                algo = "sha256";
            };
            /* cipher {
                algo = "aes256";
                key-name-hint = "kernelkey";
                //iv-name-hint = "aesiv"; // Remove this for IV in the FIT image
            }; */
        };
        fdt-1 {
            description = "Normal DTB";
            data = /incbin/("./boot.dtb");
            type = "flat_dt";
            arch = "arm64";
            compression = "none";
            load = <0x03000000>;
            hash-1 {
                algo = "sha256";
            };
            /* cipher {
                algo = "aes256";
                key-name-hint = "ubootkey";
            }; */
        };
        fdt-2 {
            description = "Rescue DTB";
            data = /incbin/("./rescue.dtb");
            type = "flat_dt";
            arch = "arm64";
            compression = "none";
            load = <0x03000000>;
            hash-1 {
                algo = "sha256";
            };
        };
        fdt-xpressreal{
            description = "XpressReal";
            data = /incbin/("./rtd1619b-xpressreal-2gb.dtb");
            type = "flat_dt";
            arch = "arm64";
            compression = "none";
            load = <0x03000000>;
            hash-1 {
                algo = "sha256";
            };
        };
        ramdisk-1 {
            description = "Rescue initrd";
            data = /incbin/("./rescue.root.cpio.xz");
            type = "ramdisk";
            arch = "arm64";
            os = "linux";
            compression = "none";
            load = <0x03100000>;
            entry = <0x03100000>;
            hash-1 {
                algo = "sha256";
            };
        };
        bootlogo {
            description = "Boot logo image";
            data = /incbin/("./bootfile.image.lzo");
            type = "firmware";
            arch = "arm64";
            compression = "lzo";
            load = <0x2F700000>;
            hash-1 {
                algo = "sha256";
            };
        };
    };
    configurations {
        default = "normal";
        normal {
            description = "Normal boot with FDT blob";
            kernel = "kernel-1";
            fdt = "fdt-1";
            signature-1 {
                algo = "sha256,rsa2048";
                key-name-hint = "kernel";
                sign-images = "fdt", "kernel";
            };
            signature-2 {
                algo = "sha256,rsa2048";
                key-name-hint = "dev";
                sign-images = "fdt", "kernel";
            };
        };
        rescue {
            description = "Rescue boot with FDT blob + initrd";
            kernel = "kernel-1";
            fdt = "fdt-2";
            ramdisk = "ramdisk-1";
            signature {
                algo = "sha256,rsa2048";
                key-name-hint = "prod";
            };
            signature-0 {
                algo = "sha256,rsa2048";
                key-name-hint = "uboot";
            };
            signature-1 {
                algo = "sha256,rsa2048";
                key-name-hint = "kernel";
                sign-images = "fdt", "kernel", "ramdisk";
            };
            signature-2 {
                algo = "sha256,rsa2048";
                key-name-hint = "dev";
                sign-images = "fdt", "kernel", "ramdisk";
            };
        };
        rtd1619b-xpressreal {
            description = "rtd1619b-xpressreal";
            kernel = "kernel-1";
            fdt = "fdt-xpressreal";
            loadables = "bootlogo";
            signature-1 {
                algo = "sha256,rsa2048";
                key-name-hint = "kernel";
                sign-images = "fdt", "kernel";
            };
            signature-2 {
                algo = "sha256,rsa2048";
                key-name-hint = "dev";
                sign-images = "fdt", "kernel";
            };
        };
    };
};
```
