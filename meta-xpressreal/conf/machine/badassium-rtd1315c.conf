## meta-xpressreal/conf/machine/include/avengers.inc
```bitbake
# meta-xpressreal default settings

require rootfs.inc

SPL_SUFFIX = "bin_pad"
SPL_BINARY = "spl/u-boot-spl.bin_pad"

PREFERRED_PROVIDER_virtual/kernel ?= "linux-yocto"
PREFERRED_VERSION_linux-yocto ?= "6.6%"

PREFERRED_VERSION_nginx = "1.24.0"

KERNEL_IMAGETYPE = "Image"

IMAGE_FSTYPES ?= "tar.bz2 wic wic.xz"

# Do not update fstab file when using wic images
WIC_CREATE_EXTRA_ARGS ?= "--no-fstab-update"

MACHINE_FEATURES:append = " SPL"

#misc
SERIAL_CONSOLES ?= "460800;ttyS0"
SERIAL_CONSOLES_CHECK ??= "${SERIAL_CONSOLES}"

INIT_MANAGER = "systemd"

KERNEL_EXTRA_FEATURES:append = "${@bb.utils.contains('MACHINE_FEATURES', 'overlayfs-root', ' features/overlayfs/overlayfs.scc', '', d)}"
EXTRA_IMAGE_FEATURES += "${@bb.utils.contains('MACHINE_FEATURES', 'overlayfs-root', ' overlayfs-root', '', d)}"
WKS_FILE ?= "${@bb.utils.contains('MACHINE_FEATURES', 'overlayfs-root', 'avengers-overlayfs.wks', 'avengers.wks', d)}"

BOOTFILES_DIR ?= "bootfiles"
IMAGE_BOOT_FILES = " \
	yocto.itb \
	"

do_image_wic[depends] += " \
	bootfiles:do_deploy \
	u-boot:do_deploy \
	"
IMAGE_INSTALL:append = " libubootenv-bin kernel-modules fwdbg dropbear sysstat"
IMAGE_INSTALL:append = " ${@bb.utils.contains('MACHINE_FEATURES', 'vendor-wifi', 'rtk-mod-wifi', '', d)}"
IMAGE_INSTALL:append = " ${@bb.utils.contains('MACHINE_FEATURES', 'upstream-wifi', 'linux-firmware-rtw', '', d)}"
IMAGE_INSTALL:append = " ${@bb.utils.contains_any('MACHINE_FEATURES', 'vendor-wifi upstream-wifi', 'wpa-supplicant hostapd', '', d)}"
IMAGE_INSTALL:append = " alsa-utils"
IMAGE_INSTALL:append = " ${@oe.utils.conditional('VIRTUAL-RUNTIME_init_manager', 'systemd', 'systemd-firmware', '', d)}"
IMAGE_INSTALL:append = " ${@oe.utils.conditional('VIRTUAL-RUNTIME_init_manager', 'systemd', 'systemd-rtk-fwlog', '', d)}"
IMAGE_INSTALL:append = " ${@bb.utils.contains('MACHINE_FEATURES', 'qt', 'qtbase qtbase-examples qtdeclarative qtdeclarative-examples qtwayland', '', d)}"
IMAGE_INSTALL:append = " ${@bb.utils.contains('MACHINE_FEATURES', 'qt', 'udev-extraconf', '', d)}"
IMAGE_INSTALL:append = " ${@bb.utils.contains('MACHINE_FEATURES', 'rtk-ui', 'rtk-qt-base', '', d)}"
IMAGE_INSTALL:append = " ${@bb.utils.contains('MACHINE_FEATURES', 'rtk-ui-plus', 'rtk-qt-plus', '', d)}"
IMAGE_INSTALL:append = " ${@bb.utils.contains('MACHINE_FEATURES', 'stt-capable', ' stt-demo rtkstt libtorch llama-cpp tinyllama-gguf', '', d)}"
IMAGE_INSTALL:append = " ${@bb.utils.contains('MACHINE_FEATURES', 'vendor-bt', 'rtkbt rtk-mod-btusb', '', d)}"
IMAGE_INSTALL:append = " ${@bb.utils.contains('MACHINE_FEATURES', 'upstream-bt', 'linux-firmware-rtlbt', '', d)}"
IMAGE_INSTALL:append = " ${@bb.utils.contains_any('MACHINE_FEATURES', 'vendor-bt upstream-bt', 'bluez5', '', d)}"

# stt and tinyllama setting
IMAGE_INSTALL:append = " ${@bb.utils.contains('MACHINE_FEATURES', 'stt-capable', ' stt-demo rtkstt libtorch llama-cpp tinyllama-gguf', '', d)}"
#IMAGE_INSTALL:append = " llama-cpp tinyllama-gguf"

# font settings
FONT_CHINESE = "ttf-droid-sans ttf-droid-sans-fallback ttf-droid-sans-mono ttf-droid-serif freetype"
IMAGE_LINGUAS:append = " ${@bb.utils.contains('MACHINE_FEATURES', 'rtk-ui', 'en-us zh-cn zh-tw', '', d)}"
IMAGE_INSTALL:append = " ${@bb.utils.contains('MACHINE_FEATURES', 'rtk-ui', "rtk-qt-base ${FONT_CHINESE}", '', d)}"

# chromium-browser
IMAGE_INSTALL:append = " ${@bb.utils.contains('MACHINE_FEATURES', 'chromium-browser', 'chromium-ozone-wayland fontconfig freetype ttf-droid-sans ttf-droid-sans-fallback ttf-droid-sans-mono ttf-droid-serif', '', d)}"

DISTRO_FEATURES:append = " ${@oe.utils.conditional('VIRTUAL-RUNTIME_init_manager', 'systemd', 'pam', '', d)}"

PREFERRED_VERSION_weston ?= "13.0.1"
PREFERRED_VERSION_mesa ?= "24.1.4"
PREFERRED_VERSION_wayland-protocols ?= "${@bb.utils.contains('MACHINE_FEATURES', 'panfrost', '1.35', '', d)}"

PREFERRED_PROVIDER_virtual/libgles1 ?= "${@bb.utils.contains('MACHINE_FEATURES', 'panfrost', 'mesa', 'libmali', d)}"
PREFERRED_PROVIDER_virtual/libgles2 ?= "${@bb.utils.contains('MACHINE_FEATURES', 'panfrost', 'mesa', 'libmali', d)}"
PREFERRED_PROVIDER_virtual/libgles3 ?= "${@bb.utils.contains('MACHINE_FEATURES', 'panfrost', 'mesa', 'libmali', d)}"
PREFERRED_PROVIDER_virtual/egl ?= "${@bb.utils.contains('MACHINE_FEATURES', 'panfrost', 'mesa', 'libmali', d)}"
PREFERRED_PROVIDER_virtual/libgbm ?= "${@bb.utils.contains('MACHINE_FEATURES', 'panfrost', 'mesa', 'libmali', d)}"
PREFERRED_PROVIDER_virtual/libgl ?= "${@bb.utils.contains('MACHINE_FEATURES', 'panfrost', 'mesa', 'libmali', d)}"
PACKAGECONFIG:remove:pn-xwayland = "${@bb.utils.contains('MACHINE_FEATURES', 'panfrost', '', 'glx', d)}"
PACKAGECONFIG:remove:pn-gstreamer1.0-plugins-base = "${@bb.utils.contains('MACHINE_FEATURES', 'panfrost', '', 'opengl glx', d)}"
IMAGE_INSTALL:append = " ${@bb.utils.contains('DISTRO_FEATURES', 'x11', 'xeyes xclock xterm xauth', '', d)}"

GSTREAMER_VERSION ?= "${@bb.utils.contains('DISTRO_FEATURES', 'stateless_v4l2', '1.24.5', '1.22.12', d )}"
PREFERRED_VERSION_gstreamer1.0 ?= "${GSTREAMER_VERSION}"
PREFERRED_VERSION_gstreamer1.0-python ?= "${GSTREAMER_VERSION}"
PREFERRED_VERSION_gstreamer1.0-libav ?= "${GSTREAMER_VERSION}"
PREFERRED_VERSION_gstreamer1.0-plugins-bad ?= "${GSTREAMER_VERSION}"
PREFERRED_VERSION_gstreamer1.0-plugins-base ?= "${GSTREAMER_VERSION}"
PREFERRED_VERSION_gstreamer1.0-plugins-good ?= "${GSTREAMER_VERSION}"
PREFERRED_VERSION_gstreamer1.0-plugins-ugly ?= "${GSTREAMER_VERSION}"

IMAGE_INSTALL:append = " rtkshmallocator rtkdmaallocator rtksubtitlepool rtkdvdspu rtksrtrender rtkassrender rtkhookqueue rtkvowb rtkmixer rtknvrsink rtkhse rtksubtitlebin rtkgridcomposer"

XSERVER ?= " \
	xserver-xorg \
	xf86-video-modesetting \
	mesa-driver-swrast \
	xserver-xorg-utils \
	xserver-xorg-extension-glx \
	xf86-input-evdev \
	xf86-input-mouse \
        "

# GPU driver selected by MACHINE_FEATURES:
# - mali + panfrost = MESA
# - mali only = Mali um/km
IMAGE_INSTALL:append = "${@(' mesa-avengers' if (bb.utils.contains('MACHINE_FEATURES', 'mali', True, False, d) and bb.utils.contains('MACHINE_FEATURES', 'panfrost', True, False, d)) else (' libmali' if bb.utils.contains('MACHINE_FEATURES', 'mali', True, False, d) else ''))}"
MACHINE_ESSENTIAL_EXTRA_RRECOMMENDS:append = "${@('' if (bb.utils.contains('MACHINE_FEATURES', 'mali', True, False, d) and bb.utils.contains('MACHINE_FEATURES', 'panfrost', True, False, d)) else (' kernel-module-mali_kbase kernel-module-dmabuf-exporter' if bb.utils.contains('MACHINE_FEATURES', 'mali', True, False, d) else ''))}"
```

## meta-xpressreal/conf/machine/include/nogui.inc
```bitbake
# meta-xpressreal settings for console only applications

DISTRO_FEATURES:remove = "x11"
DISTRO_FEATURES:remove = "opengl"
DISTRO_FEATURES:remove = "wayland"
DISTRO_FEATURES:remove = "vulkan"

IMAGE_INSTALL:remove = "alsa-utils"
# supported by libmali
IMAGE_INSTALL:remove = "vulkan-headers"
IMAGE_INSTALL:remove = "vulkan-loader"
IMAGE_INSTALL:remove = "vulkan-tools"
IMAGE_INSTALL:remove = "vulkan-samples"
IMAGE_INSTALL:remove = "vkcube"
IMAGE_INSTALL:remove = "rtkgpuconverter"
```

## meta-xpressreal/conf/machine/include/prince.inc
```bitbake
# add a common override for all rtd1635 based board

MACHINEOVERRIDES =. "prince:"

require conf/machine/include/arm/armv8-2a/tune-cortexa55.inc
require conf/machine/include/avengers.inc
require conf/machine/include/overlayfs.inc

#UBOOT_MACHINE = "rtd1635_emmc_defconfig"
UBOOT_CONFIG ??= "rtd1635_emmc"
UBOOT_CONFIG[rtd1635_emmc] = "rtd1635_evb_defconfig,,u-boot.itb"

IMAGE_BOOT_FILES += " \
	u-boot.bin-rtd1635_emmc \
	"
IMAGE_BOOT_FILES:append = " ${@bb.utils.contains('MACHINE_FEATURES', 'SPL', 'rtd1635_emmc_bind.bin', '', d)}"

KERNEL_DEVICETREE = " \
	realtek/rtd1761b-rose-8gb-hdmi.dtb \
	realtek/rtd1761-rescue.dtb \
	"

IMAGE_INSTALL:append = " ${@bb.utils.contains('MACHINE_FEATURES', 'drm', 'linux-firmware-rtd1635', '', d)}"

IMAGE_INSTALL:append = " ${@bb.utils.contains('MACHINE_FEATURES', 'npu', 'libnpu', '', d)}"
IMAGE_INSTALL:append = " ${@bb.utils.contains('MACHINE_FEATURES', 'npu', 'rtk-mod-npu', '', d)}"
IMAGE_INSTALL:append = " ${@bb.utils.contains('MACHINE_FEATURES', 'npu', 'libnpu-header', '', d)}"
```

## meta-xpressreal/conf/machine/realtekevb-rtd16xx-android.conf
```bitbake
#@TYPE: Machine
#@NAME: Realtek Stark and Kent EVM boards
#@DESCRIPTION: Machine configuration for the RTD1619b and RTD1625 boards with Android

#PREFERRED_VERSION_linux-yocto ?= "6.12%"
# Only for android16-6.12
#KERNEL_FEATURES:append: = " rust"
PREFERRED_VERSION_rust ?= "1.88.%"
PREFERRED_VERSION_rust-native ?= "1.88.%"
PREFERRED_VERSION_cargo ?= "1.88.%"
PREFERRED_VERSION_cargo-native ?= "1.88.%"
PREFERRED_VERSION_libstd-rs ?= "1.88.%"

MACHINE_FEATURES := "drm mali"
MACHINE_FEATURES += "android"
MACHINE_FEATURES += "panfrost"
MACHINE_FEATURES += "v4l2"
MACHINE_FEATURES += "mipi"
MACHINE_FEATURES += "upstream-bt"
MACHINE_FEATURES += "vendor-wifi"

MACHINEOVERRIDES =. "rtd16xx:"
#require conf/machine/include/arm/armv8-2a/tune-cortexa78.inc
require conf/machine/include/arm/armv8-2a/tune-cortexa55.inc
require conf/machine/include/avengers.inc
require conf/machine/include/overlayfs.inc

UBOOT_CONFIG = "rtd1619b_emmc rtd1625_emmc"
UBOOT_CONFIG[rtd1619b_emmc] = "rtd1619b_emmc_defconfig,,u-boot.itb"
UBOOT_CONFIG[rtd1625_emmc] = "rtd1625_phantom_defconfig,,u-boot.itb"

IMAGE_BOOT_FILES += " \
	yocto.itb \
	u-boot.bin-rtd1619b_emmc \
	u-boot.bin-rtd1625_emmc \
	"

KERNEL_DEVICETREE = " \
	realtek/rtd1619b-bleedingedge-2gb.dtb \
	realtek/rtd1619b-backinblack-2gb.dtb \
	realtek/rtd1619b-rescue.dtb \
	realtek/rtd1501s-phantom-chromium-8gb.dtb \
	realtek/rtd1501-rescue.dtb \
	"

IMAGE_INSTALL:append = " ${@bb.utils.contains('MACHINE_FEATURES', 'drm', 'linux-firmware-rtd1619b linux-firmware-rtd1625', '', d)}"
```

## meta-xpressreal/recipes-bsp/bootfiles/files/image-rtd16xx.its
```
/dts-v1/;

/ {
    description = "U-Boot fitImage for rtd16xx eMMC aarch64 kernel";
    #address-cells = <1>;

    images {
        kernel-1 {
            description = "Linux Kernel";
            data = /incbin/("./kernel.lz4");
            type = "kernel";
            arch = "arm64";
            os = "linux";
            compression = "lz4";
            load = <0x01000000>;
            entry = <0x01000000>;
            hash-1 {
                algo = "sha256";
            };
            /* cipher {
                algo = "aes256";
                key-name-hint = "kernelkey";
                //iv-name-hint = "aesiv"; // Remove this for IV in the FIT image
            }; */
        };
        fdt-rtd1619b-rescue {
            description = "rtd1619b rescue DTB";
            data = /incbin/("./rtd1619b-rescue.dtb");
            type = "flat_dt";
            arch = "arm64";
            compression = "none";
            load = <0x03000000>;
            hash-1 {
                algo = "sha256";
            };
        };
        fdt-bleedingedge{
            description = "BleedingEdge";
            data = /incbin/("./rtd1619b-bleedingedge-2gb.dtb");
            type = "flat_dt";
            arch = "arm64";
            compression = "none";
            load = <0x03000000>;
            hash-1 {
                algo = "sha256";
            };
        };
        fdt-backinblack{
            description = "BackinBlack";
            data = /incbin/("./rtd1619b-backinblack-2gb.dtb");
            type = "flat_dt";
            arch = "arm64";
            compression = "none";
            load = <0x03000000>;
            hash-1 {
                algo = "sha256";
            };
        };
        fdt-rtd1501-rescue {
            description = "rtd1501 rescue DTB";
            data = /incbin/("./rtd1501-rescue.dtb");
            type = "flat_dt";
            arch = "arm64";
            compression = "none";
            load = <0x03000000>;
            hash-1 {
                algo = "sha256";
            };
        };
        fdt-phantom{
            description = "Phantom";
            data = /incbin/("./rtd1501s-phantom-chromium-8gb.dtb");
            type = "flat_dt";
            arch = "arm64";
            compression = "none";
            load = <0x03000000>;
            hash-1 {
                algo = "sha256";
            };
        };
        ramdisk-1 {
            description = "Rescue initrd";
            data = /incbin/("./rescue.root.cpio.xz");
            type = "ramdisk";
            arch = "arm64";
            os = "linux";
            compression = "none";
            load = <0x03100000>;
            entry = <0x03100000>;
            hash-1 {
                algo = "sha256";
            };
        };
    };
    configurations {
        rtd1619b-rescue {
            description = "rtd1619b rescue boot with FDT blob + initrd";
            kernel = "kernel-1";
            fdt = "fdt-rtd1619b-rescue";
            ramdisk = "ramdisk-1";
            signature {
                algo = "sha256,rsa2048";
                key-name-hint = "prod";
            };
            signature-0 {
                algo = "sha256,rsa2048";
                key-name-hint = "uboot";
            };
            signature-1 {
                algo = "sha256,rsa2048";
                key-name-hint = "kernel";
                sign-images = "fdt", "kernel", "ramdisk";
            };
            signature-2 {
                algo = "sha256,rsa2048";
                key-name-hint = "dev";
                sign-images = "fdt", "kernel", "ramdisk";
            };
        };
        rtd1619b-bleedingedge-emmc {
            description = "rtd1619b-bleedingedge-emmc";
            kernel = "kernel-1";
            fdt = "fdt-bleedingedge";
            signature-1 {
                algo = "sha256,rsa2048";
                key-name-hint = "kernel";
                sign-images = "fdt", "kernel";
            };
            signature-2 {
                algo = "sha256,rsa2048";
                key-name-hint = "dev";
                sign-images = "fdt", "kernel";
            };
        };
        rtd1619b-backinblack {
            description = "rtd1619b-backinblack";
            kernel = "kernel-1";
            fdt = "fdt-backinblack";
            signature-1 {
                algo = "sha256,rsa2048";
                key-name-hint = "kernel";
                sign-images = "fdt", "kernel";
            };
            signature-2 {
                algo = "sha256,rsa2048";
                key-name-hint = "dev";
                sign-images = "fdt", "kernel";
            };
        };
        rtd1501-rescue {
            description = "rtd1501 escue boot with FDT blob + initrd";
            kernel = "kernel-1";
            fdt = "fdt-rtd1501-rescue";
            ramdisk = "ramdisk-1";
            signature {
                algo = "sha256,rsa2048";
                key-name-hint = "prod";
            };
            signature-0 {
                algo = "sha256,rsa2048";
                key-name-hint = "uboot";
            };
            signature-1 {
                algo = "sha256,rsa2048";
                key-name-hint = "kernel";
                sign-images = "fdt", "kernel", "ramdisk";
            };
            signature-2 {
                algo = "sha256,rsa2048";
                key-name-hint = "dev";
                sign-images = "fdt", "kernel", "ramdisk";
            };
        };
        rtd1501s-phantom {
            description = "rtd1501s-phantom";
            kernel = "kernel-1";
            fdt = "fdt-phantom";
            signature-1 {
                algo = "sha256,rsa2048";
                key-name-hint = "kernel";
                sign-images = "fdt", "kernel";
            };
            signature-2 {
                algo = "sha256,rsa2048";
                key-name-hint = "dev";
                sign-images = "fdt", "kernel";
            };
        };
    };
};
```
