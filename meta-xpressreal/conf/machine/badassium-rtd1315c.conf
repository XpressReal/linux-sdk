## meta-xpressreal/recipes-bsp/u-boot/files/src/board/realtek/Kconfig
```kconfig
config BOARD_FIT_CONFIG_NAME
	string "Board configuration name"
	default ""

config NO_RELOCATION
	bool "CONFIG_NO_RELOCATION"
	default y

config HEAP_ADDR
	hex "CONFIG_HEAP_ADDR"
	default 0x14000000

config REALTEK_I2C
	bool "CONFIG_REALTEK_I2C"
	default y

config RTL8168
	bool "CONFIG_RTL8168"
	default y

config USB_BOOT_GPIO_NUM
	int "CONFIG_USB_BOOT_GPIO_NUM"
	depends on USB_STORAGE
	default 26 if TARGET_RTD1619B
	default -1 if TARGET_RTD1625
	help
	  Set GPIO number to trigger USB boot in both U-Boot SPL/proper w/o pinmux change.
	  Values:
	  > 0: detect for GPIO input
	  0: always try in U-Boot SPL
	  < 0: disable USB boot
```

## meta-xpressreal/recipes-bsp/u-boot/files/src/common/rtk_fss_scan_smc/Kconfig
```kconfig
config RTK_FSS_SCAN_SMC
	bool "Realtek FSS Scan via SMC"
	select RTK_OPP
	help
	  Enable Realtek FSS scan via SMC call to update CPU OPP voltage table.
```

## meta-xpressreal/recipes-bsp/u-boot/files/src/configs/rtd1625_snand_defconfig
```kconfig
CONFIG_ARM=y
CONFIG_SKIP_LOWLEVEL_INIT=y
CONFIG_ARM_SMCCC=y
CONFIG_ARCH_REALTEK=y
CONFIG_BOARD_FIT_CONFIG_NAME="rtd1501s-phantom"
CONFIG_TEXT_BASE=0x03F60000
CONFIG_SYS_MALLOC_LEN=0x08000000
CONFIG_SYS_MALLOC_F_LEN=0x08000000
# CONFIG_SYS_MALLOC_CLEAR_ON_INIT is not set
CONFIG_LOCALVERSION="-kent"
CONFIG_NR_DRAM_BANKS=6
CONFIG_ENV_IS_NOWHERE=y
CONFIG_SYS_REDUNDAND_ENVIRONMENT=y
CONFIG_SYS_RELOC_GD_ENV_ADDR=y
CONFIG_SPL_DM_SPI=y
CONFIG_USE_DEFAULT_ENV_FILE=y
CONFIG_DEFAULT_ENV_FILE="board/realtek/rtd1625_snand.env"
CONFIG_DEFAULT_DEVICE_TREE="rtd1501s-phantom"
CONFIG_SYS_BOOTM_LEN=0x02000000
CONFIG_SPL_TEXT_BASE=0x03F00000
CONFIG_SPL_MAX_FOOTPRINT=0x00060000
CONFIG_SPL_MAX_SIZE=0x2AFE0
CONFIG_SPL_PAD_TO=0x2AFE0
CONFIG_SPL_BSS_MAX_SIZE=0x4000
CONFIG_SPL_SYS_MALLOC=y
CONFIG_SPL_HAS_CUSTOM_MALLOC_START=y
CONFIG_SPL_CUSTOM_SYS_MALLOC_ADDR=0x14000000
CONFIG_SPL_SYS_MALLOC_SIZE=0x08000000
# CONFIG_SPL_SEPARATE_BSS is not set
CONFIG_TARGET_RTD1625=y
#CONFIG_REQUIRE_SERIAL_CONSOLE
CONFIG_DM_SERIAL=y
CONFIG_SPL_NS16550_MIN_FUNCTIONS=y
CONFIG_SPL_SERIAL=y
CONFIG_SPL=y
CONFIG_SPL_FS_FAT=y
CONFIG_SPL_FS_LOAD_PAYLOAD_NAME="u-boot.bin-rtd1625_spi"
CONFIG_SPL_SPI=y
# CONFIG_PSCI_RESET is not set
CONFIG_BUILD_TARGET="u-boot.itb"
CONFIG_SYS_CUSTOM_LDSCRIPT=y
CONFIG_SYS_LDSCRIPT="arch/arm/mach-realtek/u-boot.lds"
CONFIG_SYS_LOAD_ADDR=0x20000000
# CONFIG_ANDROID_BOOT_IMAGE is not set
CONFIG_HAS_CUSTOM_SYS_INIT_SP_ADDR=y
CONFIG_CUSTOM_SYS_INIT_SP_ADDR=0x14000000
CONFIG_FIT_VERBOSE=y
CONFIG_FIT_CIPHER=y
CONFIG_FIT_SIGNATURE=y
CONFIG_SPL_LOAD_FIT=y
CONFIG_SPL_LOAD_FIT_APPLY_OVERLAY=y
CONFIG_SPL_FIT_CIPHER=y
CONFIG_SPL_FIT_SIGNATURE=y
CONFIG_SPL_FIT_SOURCE="board/realtek/rtd1625_emmc.its"
# CONFIG_USE_SPL_FIT_GENERATOR is not set
# CONFIG_BOOTMETH_EXTLINUX is not set
# CONFIG_BOOTMETH_VBE is not set
CONFIG_OF_BOARD=y
CONFIG_OF_BOARD_SETUP=y
CONFIG_OF_STDOUT_VIA_ALIAS=y
# CONFIG_BOOTSTD is not set
CONFIG_BOOTDELAY=0
CONFIG_USE_BOOTCOMMAND=y
CONFIG_SYS_CONSOLE_IS_IN_ENV=y
CONFIG_MISC_INIT_R=y
CONFIG_SPL_BOARD_INIT=y
# CONFIG_SPL_RAW_IMAGE_SUPPORT is not set
CONFIG_SPL_SYS_MALLOC_SIMPLE=y
# 128KB block: 28-th block
CONFIG_SYS_SPI_U_BOOT_OFFS=0x380000
# 256KB block: 20-th block
#CONFIG_SYS_SPI_U_BOOT_OFFS=0x500000
CONFIG_SYS_USB_FAT_BOOT_PARTITION=1
CONFIG_HUSH_PARSER=y
CONFIG_SYS_PROMPT="Realtek> "
CONFIG_SYS_CBSIZE=640
CONFIG_SYS_PBSIZE=665
# CONFIG_CMD_CONSOLE is not set
# CONFIG_CMD_BOOTD is not set
# CONFIG_BOOTM_VXWORKS is not set
# CONFIG_CMD_IMI is not set
# CONFIG_CMD_XIMG is not set
# CONFIG_CMD_EXPORTENV is not set
CONFIG_CMD_IMPORTENV=y
# CONFIG_CMD_CRC32 is not set
CONFIG_CMD_GPT=y
# CONFIG_CMD_LOADS is not set
CONFIG_CMD_MBR=y
CONFIG_CMD_MTD=y
CONFIG_CMD_PART=y
CONFIG_CMD_READ=y
CONFIG_CMD_USB=y
CONFIG_CMD_USB_MASS_STORAGE=y
# CONFIG_CMD_RTK_PMIC is not set
CONFIG_CMD_ECHO=y
CONFIG_CMD_TFTPPUT=y
# CONFIG_CMD_NFS is not set
CONFIG_CMD_PING=y
CONFIG_CMD_CACHE=y
CONFIG_CMD_GETTIME=y
CONFIG_CMD_EXT2=y
CONFIG_CMD_FAT=y
CONFIG_CMD_FS_GENERIC=y
CONFIG_CMD_HASH=y
CONFIG_CMD_MTDPARTS=y
# spi-nor
#CONFIG_MTDIDS_DEFAULT="nor0=RtkSFC"
#CONFIG_MTDPARTS_DEFAULT="mtdparts=RtkSFC:1M(bootcode)ro,768K@0x100000(u-boot)"
# spi-nand
CONFIG_MTDIDS_DEFAULT="spi-nand0=rtknand"
# 128KB block
CONFIG_MTDPARTS_DEFAULT="mtdparts=rtknand:2M(boot)ro,1M(trustfw),512K(spl),1536K(u-boot),128K(env),128K(env_r),24M(ubi),90M(rootfs),2M(pstore),-(bb)ro"
# 256KB block
#CONFIG_MTDPARTS_DEFAULT="mtdparts=rtknand:3584K(boot)ro,1M(trustfw),512K(spl),1536K(u-boot),256K(env),256K(env_r)"
CONFIG_OF_CONTROL=y
CONFIG_OF_OVERLAY_LIST="cipher rtd1501-tee"
CONFIG_SPL_OF_CONTROL=y
CONFIG_SPL_MULTI_DTB_FIT=y
CONFIG_OF_LIVE=y
CONFIG_ENV_OVERWRITE=y
CONFIG_TFTP_BLOCKSIZE=400
CONFIG_DM=y
CONFIG_SPL_DM=y
CONFIG_REGMAP=y
CONFIG_SPL_REGMAP=y
CONFIG_SYSCON=y
CONFIG_SPL_OF_TRANSLATE=y
# CONFIG_BLK is not set
CONFIG_MISC=y
CONFIG_MTD=y

CONFIG_PHY_RTK_RTD_USB2PHY=y
CONFIG_PHY_RTK_RTD_USB3PHY=y
CONFIG_BAUDRATE=460800
CONFIG_SYS_NS16550=y
#CONFIG_SYS_NS16550_SERIAL=y
CONFIG_SYS_NS16550_REG_SIZE=-4
CONFIG_SPI=y
CONFIG_USB=y
CONFIG_DM_SPI=y
CONFIG_DM_USB_GADGET=y
CONFIG_USB_XHCI_HCD=y
CONFIG_USB_DWC3=y
CONFIG_USB_DWC3_GENERIC=y
CONFIG_USB_STORAGE=y
CONFIG_USB_GADGET=y
CONFIG_USB_GADGET_MANUFACTURER="Realtek U-Boot"
CONFIG_USB_GADGET_VENDOR_NUM=0x18d1
CONFIG_USB_GADGET_PRODUCT_NUM=0x4e40
CONFIG_USB_FUNCTION_MASS_STORAGE=y
CONFIG_USB_MAX_CONTROLLER_COUNT=4
CONFIG_FAT_WRITE=y
# CONFIG_SPL_SHA1 is not set
CONFIG_LZO=y
CONFIG_OPTEE_LIB=y
# CONFIG_EFI_LOADER is not set
CONFIG_CLK=y
CONFIG_DM_GPIO=y
CONFIG_CMD_GPIO=y
CONFIG_REALTEK_GPIO=y

# CONFIG_SPL_DOS_PARTITION is not set
# CONFIG_SPL_EFI_PARTITION is not set

# For U-Boot script support
#CONFIG_LEGACY_IMAGE_FORMAT=y
#CONFIG_SYS_USB_FAT_BOOT_PARTITION=12

# I2C/PCI-E/NVME
#CONFIG_DM_I2C=y
#CONFIG_SYS_I2C_RTK=y
#CONFIG_CMD_I2C=y
#CONFIG_PCI=y
#CONFIG_PCIE_RTD=y
#CONFIG_CMD_PCI=y
#CONFIG_NVME=y
#CONFIG_NVME_PCI=y
#CONFIG_PHY_RTD_PCIE=y

# SPI-NOR
CONFIG_SPI_RTK_SFC=y
CONFIG_SPL_SPI_FLASH_SUPPORT=y
CONFIG_SPL_DM_SPI_FLASH=y
# CONFIG_SPL_SPI_FLASH_TINY is not set
CONFIG_SPL_SPI_LOAD=y
CONFIG_DM_SPI_FLASH=y
CONFIG_SPI_FLASH_GIGADEVICE=y
CONFIG_SPI_FLASH_WINBOND=y
CONFIG_SPI_FLASH_MTD=y
# CONFIG_SPI_FLASH_USE_4K_SECTORS is not set
#CONFIG_ENV_IS_IN_SPI_FLASH=y
#CONFIG_ENV_OFFSET=0
#CONFIG_ENV_OFFSET_REDUND=0x10000
#CONFIG_ENV_SECT_SIZE_AUTO=y
#CONFIG_ENV_SECT_SIZE=0x1000
#CONFIG_ENV_SIZE=0x10000

# SPI-NAND
# CONFIG_MMC is not set
CONFIG_SPI_RTK_NAND=y
CONFIG_SPL_SPI_RTK_NAND=y
CONFIG_SPL_MTD_SUPPORT=y
CONFIG_SPL_SPI_FLASH_SUPPORT=y
CONFIG_SPL_SPI_NAND_LOAD=y
CONFIG_DM_MTD=y
CONFIG_MTD_SPI_NAND=y
# Required for SPL_UBI
CONFIG_SPL_LOAD_FIT_FULL=y
CONFIG_SPL_UBI=y
# 24MB UBI on 128KB block
CONFIG_SPL_UBI_MAX_VOL_LEBS=192
CONFIG_SPL_UBI_MAX_PEB_SIZE=131072
CONFIG_SPL_UBI_MAX_PEBS=1024
CONFIG_SPL_UBI_PEB_OFFSET=42
CONFIG_SPL_UBI_VID_OFFSET=2048
CONFIG_SPL_UBI_LEB_START=4096
CONFIG_SPL_UBI_INFO_ADDR=0x07880000
CONFIG_SPL_UBI_VOL_IDS=4
CONFIG_SPL_UBI_LOAD_MONITOR_ID=0
CONFIG_SPL_UBI_LOAD_BY_VOLNAME=y
CONFIG_SPL_UBI_LOAD_MONITOR_VOLNAME="uboot"
CONFIG_ENV_IS_IN_MTD=y
CONFIG_ENV_MTD_DEV="spi-nand0"
# 128KB block
CONFIG_ENV_SIZE=0x20000
CONFIG_ENV_OFFSET=0x500000
CONFIG_ENV_OFFSET_REDUND=0x520000
# 256KB block
#CONFIG_ENV_SIZE=0x40000
#CONFIG_ENV_OFFSET=0x680000
#CONFIG_ENV_OFFSET_REDUND=0x6C0000
CONFIG_CMD_UBI=y
# CONFIG_CMD_UBIFS is not set
#CONFIG_CMD_MTD_MARKBAD=y
#CONFIG_CMD_MTD_OTP=y
CONFIG_CMD_MTD_NAND_READ_TEST=y
#CONFIG_CMD_MTD_NAND_WRITE_TEST=y

# Enable LOG for debug
#CONFIG_LOGLEVEL=9
#CONFIG_LOG=y
#CONFIG_LOG_MAX_LEVEL=9
#CONFIG_SPL_LOG=y
#CONFIG_SPL_LOG_MAX_LEVEL=9
```

## meta-xpressreal/recipes-kernel/linux/files-5.10/avengers-kmeta/bsp/Documentation/devicetree/bindings/display/realtek/realtek,rtk-hdmi.txt
```
Realtek hdmi output driver

Required properties:
  - compatible: should be "realtek,rtk-hdmi"
  - syscon: phandle to syscon used to access hdmi registers
  - clocks: phandle to crt clock enable
  - clock-names: should be "clk_en_hdmi"
  - resets: phandle to crt reset
  - reset-names: should be "rstn_hdmi"
  - hpd-gpios: hotplug gpio pin

Optional properties:
  - rxsense-mode:
	- <0>: PASSIVE_MODE(default)
	- <1>: TIMER_MODE
	- <2>: INTERRUPT_MODE
  - hdcp:
	- <0>: No hdcp(default)
	- <1>: hdcp 1.4
	- <2>: hdcp 2.x

Examples:
	hdmi: hdmi@9800d000 {
		compatible = "realtek,rtk-hdmi";
		syscon = <&hdmi_tx>, <&crt>, <&hdmi_top>;
		clocks = <&cc RTD1319D_CRT_CLK_EN_HDMI>;
		clock-names = "clk_en_hdmi";
		resets = <&cc RTD1319D_CRT_RSTN_HDMI>;
		reset-names = "rstn_hdmi";
		hpd-gpios = <&gpio 7 GPIO_PULL_DOWN>;
		rxsense-mode = <0>;
		hdcp = <0>;
		hdmi_in: port {
			hdmi_vo: endpoint {
				remote-endpoint = <&vo_hdmi>;
			};
		};
	};
```

## meta-xpressreal/recipes-kernel/linux/files-5.10/avengers-kmeta/bsp/Documentation/devicetree/bindings/hwlock/rtk,hwspinlock.yaml
```yaml
# SPDX-License-Identifier: (GPL-2.0-only or BSD-2-Clause)
%YAML 1.2
---
$id: http://devicetree.org/schemas/hwlock/rtk,hwspinlock.yaml#
$schema: http://devicetree.org/meta-schemas/core.yaml#

title: HwSpinlock for Realtek Soc

properties:
  compatible:
    enum:
      - realtek,hwlock

  reg:
    maxItems: 1

  "#hwlock-cells":
    const: 1
    description: |
      Please look at the generic hwlock binding for usage information for
      consumers, "Documentation/devicetree/bindings/hwlock/hwlock.txt"

  realtek,lock-id-maps:
    description: |
      An optional property. If this property exists, use the id-map
      defined in the property for the locks. Otherwise use direct register
      map.
    $ref: /schemas/types.yaml#definitions/phandle-array

required:
  - compatible
  - reg
  - "#hwlock-cells"

additionalProperties: false

examples:

  - |
    /* add a hwlock */
    lock0: hwlock@1a000 {
	compatible = "realtek,hwlock";
	reg = <0x1a000 0x4>;
	#hwlock-cells = <1>;
    };

    dev {
	hwlocks = <&lock0 0>;
    };


  - |
    /* add hwlocks from continue reg */
    lock1: hwlock@1a620 {
	compatible = "realtek,hwlock";
	reg = <0x1a620 0x10>;
	#hwlock-cells = <1>;
    };

    dev {
	hwlocks = <&lock1 0>, <&lock1 1>, <&lock1 2>, <&lock1 3>;
    };

  - |
    /* add hwlocks based on id map */
    lock2: hwlock@1a630 {
	compatible = "realtek,hwlock";
	reg = <0x1a630 0x4>;
	#hwlock-cells = <1>;
	realtek,lock-id-maps = <0 0>; /* both 2 hwlocks is using the one in offset 0 */
    };

    dev {
	hwlocks = <&lock2 0>, <&lock2 1>;
    };
```

## meta-xpressreal/recipes-kernel/linux/files-5.10/avengers-kmeta/bsp/Documentation/devicetree/bindings/soc/realtek/bootstatus.yaml
```yaml
# SPDX-License-Identifier: (GPL-2.0-only or BSD-2-Clause)
%YAML 1.2
---
$id: http://devicetree.org/schemas/soc/realtek/bootstatus.yaml#
$schema: http://devicetree.org/meta-schemas/core.yaml#

title: Realtek Bootstatus

properties:
  compatible:
    enum:
      - realtek,rtd1619-bootstatus
      - realtek,rtd1319-bootstatus
      - realtek,rtd1619b-bootstatus

  realtek,boot-type:
    $ref: /schemas/types.yaml#definitions/phandle-array
    description: |
      a syscon with offset to a boot-type register

  realtek,sw-cold-boot-count:
    $ref: /schemas/types.yaml#definitions/phandle-array
    description: |
      a syscon with offset to a sw-cold-boot-count register.

  realtek,reboot-reason:
    $ref: /schemas/types.yaml#/definitions/string
    description: |
      a string contains reboot reason.

required:
  - compatible

additionalProperties: false

examples:
  - |
    /* add a hwlock */
    bootstatus {
      compatible = "realtek,rtd1619b-bootstatus";
      realtek,boot-type = <&iso 0x678>;
      realtek,sw-cold-boot-count = <&iso 0x644>;
    };
```

## meta-xpressreal/recipes-kernel/linux/files-5.10/avengers-kmeta/bsp/Documentation/devicetree/bindings/watchdog/rtk-wdt.yaml
```yaml
# SPDX-License-Identifier: (GPL-2.0-only OR BSD-2-Clause)
%YAML 1.2
---
$id: http://devicetree.org/schemas/watchdog/rtk-wdt.yaml#
$schema: http://devicetree.org/meta-schemas/core.yaml#

title: Realtek Watchdog Bindings

maintainers:
  - Cheng Yu Lee <cylee12@realtek.com>

allOf:
  - $ref: watchdog.yaml#

properties:
  compatible:
    enum:
      - realtek,watchdog

  reg:
    minItems: 1
    maxItems: 2

  realtek,ov-rstb-oe:
    enum: [0, 1]

  realtek,ov-rstb-oe-init:
    enum: [0, 1]

  realtek,ignore-restart:
    $ref: /schemas/types.yaml#/definitions/boolean

  interrupts:
     maxItems: 1

  timeout-sec:
    description:
      Contains the watchdog timeout in seconds.

required:
  - compatible
  - reg

unevaluatedProperties: false

examples:
  - |
    // watchdog
    watchdog@2a0 {
      compatible = "realtek,watchdog";
      reg = <0xa20 0x10>, <0xa30 0x8>;
      timeout-sec = <20>;
      interrupts-extended = <&iso_irq_mux 4>;
      realtek,ov-rstb-oe-init = <1>;
      realtek,ov-rstb-oe = <0>;
    };

  - |
    // watchdog without ov-rstb ctrl
    watchdog@5b0 {
      compatible = "realtek,watchdog";
      reg = <0x5b0 0x20>;
      interrupts-extended = <&misc_irq_mux 2>;
      timeout-sec = <20>;
      realtek,ignore-restart;
    };

  - |
    // watchdog without pretimeout
    watchdog@680 {
      compatible = "realtek,reboot";
      reg = <0x680 0x10>, <0x690 0x8>;
      realtek,ov-rstb-oe-init = <1>;
      realtek,ov-rstb-oe = <0>;
    };
```

## meta-xpressreal/recipes-kernel/linux/files-5.10/avengers-kmeta/bsp/drivers/media/platform/rtk_hdmitx/Kconfig
```kconfig
#Copyright (C) 2017 Realtek Semiconductor Corporation

config RTK_HDMITX
	tristate "HDMITX for Realtek platform"
	select I2C
	select SWITCH
	select CEC_RTK
    select RTK_RPC
	default n
	help
	  Say Y, if you want to enable HDMITX feature on Realtek platform.

choice
	prompt "RTK HDMI model"
	depends on RTK_HDMITX
	default RTK_HDMI_RTD16XXB

config RTK_HDMI_RTD13XX
	bool "RTD13xx"

config RTK_HDMI_RTD16XXB
	bool "RTD16xxb"

config RTK_HDMI_RTD1315E
	bool "RTD1315e"

config RTK_HDMI_RTD1325
	bool "RTD1325"

endchoice
```

## meta-xpressreal/recipes-kernel/linux/files-5.10/avengers-kmeta/bsp/drivers/media/platform/rtk_teeapi/Kconfig
```kconfig
#Copyright (C) 2017 Realtek Semiconductor Corporation

config RTK_TEEAPI
        tristate "Realtek TEE API Client"
        depends on TEE
        help
                Realtek TEE API Client
```
