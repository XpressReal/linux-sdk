## meta-xpressreal/recipes-kernel/linux/files-5.10/avengers-kmeta/bsp/drivers/soc/realtek/Kconfig
```kconfig
menu "Realtek SoC drivers"

config RTK_RESERVE_MEMORY
	bool "RTK Reserve Memory for Video/Image Codec"
	default n

config RTK_PUWRAP
	tristate
	select RTK_RESERVE_MEMORY

config RTK_IMAGE_CODEC
	tristate "RTK Image Codec"
	select RTK_PUWRAP
	default y

menuconfig RTD13XX_RTK_CODEC
	tristate "Realtek RTD13XX Codec"
	select RTK_RESERVE_MEMORY
	default n
	help
	  Realtek RTD13XX codec support.

	  If unsure, say N.

config RTD13XX_VE1_CODEC
	tristate "RTK Video Engine 1 Codec"
	depends on RTD13XX_RTK_CODEC
	select RTK_PUWRAP
	default n

menuconfig RTD13XXD_RTK_CODEC
	tristate "Realtek RTD13XXD Codec"
	select RTK_RESERVE_MEMORY
	default n
	help
	  Realtek RTD13XXD codec support.

	  If unsure, say N.

config RTD13XXD_VE1_CODEC
	tristate "RTK Video Engine 1 Codec"
	depends on RTD13XXD_RTK_CODEC
	select RTK_PUWRAP
	default n

menuconfig RTD13XXE_RTK_CODEC
        tristate "Realtek RTD13XXE Codec"
        select RTK_RESERVE_MEMORY
        default n
        help
          Realtek RTD13XXE codec support.

          If unsure, say N.

config RTD13XXE_VE1_CODEC
        tristate "RTK Video Engine 1 Codec"
        depends on RTD13XXE_RTK_CODEC
        select RTK_PUWRAP
        default n

menuconfig RTD16XXB_RTK_CODEC
	tristate "Realtek RTD16XXB Codec"
	select RTK_RESERVE_MEMORY
	default n
	help
	  Realtek RTD16XXB codec support.

	  If unsure, say N.

config RTD16XXB_VE1_CODEC
	tristate "RTK Video Engine 1 Codec"
	depends on RTD16XXB_RTK_CODEC
	select RTK_PUWRAP
	default n

config REALTEK_SOC
	bool
	depends on ARCH_REALTEK
	default y
	help
	  Realtek SoC drivers.

	  If unsure, say N.

menuconfig RTK_CODEC
	tristate "Realtek Codec"
	default n
	help
	  Realtek codec support.

	  If unsure, say N.

config RTK_VE1
	tristate "RTK Video Engine 1 Codec"
	depends on RTK_CODEC
	default n

config RTK_VE1_V4L2_BEHAVIOR
	bool "RTK VE1 V4L2 stateful behavior"
	depends on RTK_VE1
	default n
	help
	  Enable V4L2 stateful decoder behavior for RTK Video Engine 1.

source "drivers/soc/realtek/common/Kconfig"
source "drivers/soc/realtek/cpudvfs/Kconfig"
source "drivers/soc/realtek/cpuhp/Kconfig"
source "drivers/soc/realtek/gpu/Kconfig"
source "drivers/soc/realtek/tee_mem/Kconfig"
source "drivers/soc/realtek/runtime_device/Kconfig"

endmenu
```

## meta-xpressreal/recipes-kernel/linux/files-5.10/avengers-kmeta/bsp/drivers/soc/realtek/common/Kconfig
```kconfig
config REALTEK_PM
	tristate "Realtek power management driver"
	default y
	help
	  Suspend to RAM and shutdown support.

config RTK_PM_ALARM
	tristate "Realtek Alarm Emulation"
	depends on REALTEK_PM
	default y
	help
	  Support for Alarm Emulation

config RTK_PM_HIFI
	tristate "Realtek HIFI PM"
	depends on REALTEK_PM
	default y
	help
	  Support for Realtek HIFI PM

config RTK_MCP
	tristate "Realtek MCP driver"
	default n
	help
	  Realtek MCP driver

config RTK_SHA1
	tristate "Realtek SHA1"
	default y if RTK_MCP
	help
	  Realtek SHA1

config RTK_SMCC
	tristate "Realtek SMCC driver"
	depends on REALTEK_SOC
	default y
	help
	  Realtek SMCC driver

config RTK_USB_CTRL_MANAGER
	tristate "RTK Multiple USB Host/Device Controller Manager"
	default y if USB_OHCI_RTK || USB_EHCI_RTK || USB_DWC3_RTK
	help
	  The Realtek chips are Multiple host/peripheral USB controllers.
	  Enable the driver to control clock, reset and usb power gpio.

config REALTEK_CHIP_INFO
	tristate "Realtek SoC information"
	default y
	select SOC_BUS
	help
	  The Realtek chips information.

config RTK_TP
	tristate "Realtek TP Device Driver"
	default y
	help
	  This driver provides PM and userspace driver interface of TP.

config RTK_FAN
	tristate "RTK Fan driver"
	default n
	help
	  Realtek Fan driver

config RTK_FSS
	tristate "Realtek FSS Driver"
	default n
	help
	  This enable Realtek FSS generic control interface.
	  If not sure say N.

config RTK_VCPU
	tristate "Realtek VCPU driver"
	select DEVFREQ_GOV_USERSPACE if PM_DEVFREQ
	default y
	help
	  This enables Realtek VCPU driver.

config RTK_VE3_UART
	tristate "Realtek VE3 uart driver"
	default y
	help
	  This enables Realtek VE3 Pseudo Uart driver.

config RTK_DPI_COORD
	tristate "Realtek DPI coordinator driver"
	default y
	help
	  This enables Realtek DPI coordinator driver

config RTK_GPIO_MANAGER
	tristate "Realtek GPIO Manager driver"
	default y
	help
	  This enables Realtek GPIO manager driver to control gpio default value and suspend/resume state.

config RTK_ACPU_VE1
	bool "Realtek ACPU VE1 Driver"
	help
	   This driver provides ACPU VE1 controls

config RTK_DBGPROT
	tristate "Realtek Debug Protection Driver"
	help
	  This driver provides Debug Protection infomation.

config RTK_MEM_REMAP
	tristate "Realtek RPC Memory Remapping"
	default y
	help
	  The driver provides memory remapping for realtek rpc mechanism.

config RTK_REFCLK
	tristate "Realtek Refclk Driver"
	default y
	help
	  The driver provides refclk.

config RTK_AVCPU_LOG
	tristate "Realtek AVCPU share memory logging system"
	depends on RPMSG_RTK_RPC
	default y
	help
	  Enable AVCPU share memory logging read from userspace
	  via device node.

config RTK_IFCP_CLIENT
	tristate "Realtek IFCP client driver"
	depends on RTK_IFCP && RTK_IFCP_MBOX
	help
	  Realtek IFCP client driver

config RTK_DEMOD
	tristate "Realtek Demod Device Driver"
	default y
	help
	  This driver provides userspace interface of Demod.

config RTK_CMA_ACCELERATOR
	tristate "Realtek CMA accelerator driver"
	default n
	depends on CMA && PM_SLEEP && ANDROID_VENDOR_HOOKS
	help
	  Choose this option if you wish to improve CMA performance.

config RTK_URPC_SERVICE
	bool "Realtek Userspace RPC Service driver"
	depends on RPMSG_RTK_RPC
	help
		Realtek Userspace RPC Service driver

config RTK_FWDBG
	bool "Realtek FWDBG driver"
	depends on RPMSG_RTK_RPC
	help
		Realtek FW Debug driver

source "drivers/soc/realtek/common/rpc/Kconfig"
source "drivers/soc/realtek/common/rpc2/Kconfig"
source "drivers/soc/realtek/common/mem_allocator/Kconfig"
source "drivers/soc/realtek/common/hse/Kconfig"
source "drivers/soc/realtek/common/buflock/Kconfig"
source "drivers/soc/realtek/common/rtk_pd/Kconfig"
source "drivers/soc/realtek/common/rtk_scd/Kconfig"
source "drivers/soc/realtek/common/rtk_ps/Kconfig"

config RTK_MDL
        tristate "Realtek MDL Driver"
        default y
        help
          Realtek MDL driver.

config RTK_SB2_INV
	tristate "Realtek SB2 Invalid Access Detection Driver"
	default y
	help
	  Enable this to show SB2 Invalid Access in kernel log.
	  This is useful for device driver implementation.

	  If not sure, say Y.

config RTK_BOOTSTATUS
	tristate "Realtek SB2 Boot Status Driver"
	default y
	help
	  Enable this to driver to provides addtional boot information
	  under '/sys/kernel/bootstatus'.

	  If not sure, say Y.

config RTK_UART_WRAPPER
	tristate "Realtek UART Wrapper"
	depends on SERIAL_8250_SHARE_IRQ
	default n
	help
	  Enable UART Wrapper driver.

config RTK_GIC_EXT
	tristate "Realtek GIC extension driver"
	default y
	help
	  GIC-v3 extension setting for Realtek DHC SoCs.

	  If not sure, say Y.

config RTK_AUTOREAD
	tristate "Realtek Hardware Autoread"
	default n
	help
	  Enable Realtek hardware autoread driver

config RTK_KRPC
	tristate "Realtek Kernel RPC driver"
	depends on RPMSG_RTK_RPC
	default y
	help
	  Realtek Kernel RPC driver

source "drivers/soc/realtek/common/dpi_tee/Kconfig"
```
