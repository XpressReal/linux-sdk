// SPDX-License-Identifier: (GPL-2.0-or-later OR BSD-2-Clause)
/*
 * Copyright (c) 2023 Realtek Semiconductor Corp.
 */

/dts-v1/;

#include "rtd1325-rescue.dtsi"

/ {
	model = "Realtek RTD1325 Rescue";

	memory@40000 {
		device_type = "memory";
		reg = <0x00040000 0x3ffc0000>; /* 1 GiB */
	};
};

&reserved_memory {
	hifi_b1p5 {
		alloc-ranges=<0x00000000 0x40000000>;
		status = "okay";
       };
};
