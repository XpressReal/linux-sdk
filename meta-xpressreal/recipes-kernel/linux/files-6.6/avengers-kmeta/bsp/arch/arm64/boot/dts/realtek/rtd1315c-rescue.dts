// SPDX-License-Identifier: GPL-2.0
/*
 * Copyright (c) 2019-2021 Realtek Semiconductor Corp.
 */

/dts-v1/;

#include "rtd16xxb-rescue.dtsi"

/ {
	model = "Realtek RTD1315C Rescue";

	memory@40000 {
		device_type = "memory";
		reg = <0x00040000 0x3ffc0000>; /* 1 GiB */
	};
};

&hdmi {
	hdmi5v-gpios = <&gpio 47 GPIO_ACTIVE_LOW>;
	hdcp = <0>;
};
