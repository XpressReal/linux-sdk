// SPDX-License-Identifier: (GPL-2.0-or-later OR BSD-2-Clause)
/*
 * Copyright (c) 2023 Realtek Semiconductor Corp.
 */

/dts-v1/;

#include "rtd1325-moby.dtsi"

/ {
	compatible = "realtek,moby", "realtek,rtd1325";
	model = "Realtek Moby EVB (2GB LPDDR4)";

	memory: memory@40000 {
		device_type = "memory";
		reg = <0x00040000 0x7ffc0000>; /* 2 GB */
	};
};
