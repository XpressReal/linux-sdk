## meta-xpressreal/recipes-kernel/linux/files-6.6/avengers-kmeta/bsp/sound/soc/sof/realtek/Kconfig
```kconfig
# SPDX-License-Identifier: (GPL-2.0-only OR BSD-3-Clause)

config SND_SOC_SOF_RTK_TOPLEVEL
	bool "SOF support for RTK audio DSPs"
	depends on SND_SOC_SOF_OF
	help
	  This adds support for Sound Open Firmware for RTK platforms.

if SND_SOC_SOF_RTK_TOPLEVEL

config SND_SOC_SOF_OF_HIFI
	tristate "SND SOF FOR RTK AUDIO"
	select SND_SOC_SOF_OF_DEV
	select SND_SOC_SOF
	select SND_SOC_SOF_IPC3
	select SND_SOC_SOF_XTENSA
	select SND_SOC_SOF_COMPRESS
	help
	  This option is not user-selectable but automagically handled by
	  'select' statements at a higher level.

endif ## SND_SOC_SOF_RTK_TOPLEVEL
```

## meta-xpressreal/wic/avengers-home.wks
```
# short-description: Create an image for Realtek Avengers based SoC image
# long-description: Creates a partitioned image for Realtek Avengers based SoC with extlinux

bootloader --ptable gpt --timeout=0

# Boot partition
part /boot --source bootimg-partition --ondisk mmcblk0 --fstype=vfat --label boot --active --align 4096 --fixed-size 20

# Ext4 root partition
part / --source rootfs --exclude-path=home/ --ondisk mmcblk0 --fstype=ext4 --label rootfs --align 4096

part /home --source rootfs --rootfs-dir=${IMAGE_ROOTFS}/home --ondisk mmcblk0 --fstype=ext4 --label home --align 1024 --size 100
```

## meta-xpressreal/wic/avengers-overlayfs.wks
```
# short-description: Create an image for Realtek Avengers based SoC image
# long-description: Creates a partitioned image for Realtek Avengers based SoC with extlinux

bootloader --ptable gpt --timeout=0

# Boot partition
part /boot --source bootimg-partition --ondisk mmcblk0 --fstype=vfat --label boot --active --align 4096 --fixed-size 20

# Squashfs root partition
part / --source rootfs --ondisk mmcblk0 --fstype=squashfs --align 4096 --mkfs-extraopts "-comp xz"

# Ext4 overlay partition
part --ondisk mmcblk0 --fstype=ext4 --label overlay --size=100 --align 4096
```

## meta-xpressreal/wic/avengers.wks
```
# short-description: Create an image for Realtek Avengers based SoC image
# long-description: Creates a partitioned image for Realtek Avengers based SoC with extlinux

bootloader --ptable gpt --timeout=0

# Boot partition
part /boot --source bootimg-partition --ondisk mmcblk0 --fstype=vfat --label boot --active --align 4096 --fixed-size 20

# Ext4 root partition
part / --source rootfs --ondisk mmcblk0 --fstype=ext4 --label rootfs --align 4096
```
