// SPDX-License-Identifier: (GPL-2.0-or-later OR BSD-2-Clause)
/*
 * Copyright (c) 2024 Realtek Semiconductor Corp.
 */

/dts-v1/;

#include "rtd1920-rescue.dtsi"

/ {
	model = "Realtek RTD1920 Rescue";

	memory: memory@50000 {
		device_type = "memory";
		reg = <0x00000000 0x00050000 0x00000000 0x3ffb0000>; /* 1 GiB */
	};

	chosen {
		stdout-path = "serial0:460800n8";
		bootargs = "console=ttyS0,460800 8250.nr_uarts=1 init=/init firmware_class.path=/vendor/firmware/,/vendor/av_fw";
		linux,initrd-start = <0x09000000>;
		linux,initrd-end = <0x0a900000>;
	};
};

&rtk_tee_mem {
	status = "okay";
 };
