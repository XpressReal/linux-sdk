## meta-xpressreal/recipes-kernel/linux/files-5.10/avengers-kmeta/bsp/drivers/soc/realtek/common/dpi_tee/Kconfig
```kconfig
config RTK_DPI_TEE
	tristate "Realtek DPI TEE driver"
	depends on TEE
	default y
	help
	  This enables Realtek DPI TEE driver
```

## meta-xpressreal/recipes-kernel/linux/files-5.10/avengers-kmeta/bsp/drivers/soc/realtek/common/rpc/Kconfig
```kconfig
config REALTEK_RPC
	tristate "Realtek RPC driver"
	depends on REALTEK_SOC
	select RTK_REFCLK
	help
	  Realtek RPC driver.

config REALTEK_RPC_VE3
	bool "Realtek VE3 RPC"
	depends on REALTEK_RPC
	help
	  Enable Realtek VE3 RPC.

config REALTEK_RPC_HIFI
	bool "Realtek HIFI RPC"
	depends on REALTEK_RPC
	help
	  Enable Realtek HIFI RPC.
```

## meta-xpressreal/recipes-kernel/linux/files-5.10/avengers-kmeta/bsp/drivers/soc/realtek/common/rpc2/Kconfig
```kconfig
config REALTEK_RPC_V2
	tristate "Realtek RPC driver v2"
	depends on REALTEK_SOC
	select RTK_REFCLK
	help
	  new Realtek RPC driver.

config RTK_VO_ON_HIFI
	tristate "Realtek VO on HIFI"
	depends on REALTEK_RPC_V2
	help
	  Enabled VO on HIFI feature.
```

## meta-xpressreal/recipes-kernel/linux/files-5.10/avengers-kmeta/bsp/drivers/soc/realtek/tee_mem/Kconfig
```kconfig
config OPTEE_MEM_API
        tristate "Realtek DHC SoC memory protection support"
        depends on OPTEE
        default y
        help
          This implements the Realtek DHC SoC's memory protection mechanism.
```

## meta-xpressreal/recipes-kernel/linux/files-6.12/avengers-kmeta/bsp/Documentation/devicetree/bindings/media/realtek,rtk-dprx.yaml
```yaml
# SPDX-License-Identifier: (GPL-2.0 OR BSD-2-Clause)
%YAML 1.2
---
$id: "http://devicetree.org/schemas/media/realtek,rtk-dprx.yaml#"
$schema: "http://devicetree.org/meta-schemas/core.yaml#"

title: Realtek SoC DisplayPort RX driver

maintainers:
  - Chase Yen <chase.yen@realtek.com>

description:
  The embedded Realtek SoC DisplayPort RX drive.

properties:
  compatible:
    enum:
      - realtek,rtk-dprx

  reg:
    maxItems: 2

  interrupts:
    maxItems: 1

  clocks:
    items:
      - description: Module Clock

  clock-names:
    items:
      - const: clk_en_dprx

  resets:
    items:
      - description: Module Reset

  reset-names:
    items:
      - const: rstn_dprx

required:
  - compatible
  - interrupts
  - clocks
  - clock-names
  - resets
  - reset-names

additionalProperties: true

examples:
  - |

    dprx: dprx@165000 {
      compatible = "realtek,rtk-dprx";
      interrupts = <GIC_SPI 23 IRQ_TYPE_LEVEL_HIGH>;
      clocks = <&cc RTD1761_CRT_CLK_EN_DPRX>;
      clock-names = "clk_en_dprx";
      resets = <&cc RTD1761_CRT_RSTN_DPRX>;
      reset-names = "rstn_dprx";
    };
```

## meta-xpressreal/recipes-kernel/linux/files-6.12/avengers-kmeta/bsp/drivers/media/platform/rtk-xdi/Kconfig
```kconfig
# SPDX-License-Identifier: GPL-2.0-only

config RTK_XDI
	tristate "RTK xDI Support"
	help
	  This enables support for Realtek xDI devices.
```

## meta-xpressreal/recipes-kernel/linux/files-6.12/avengers-kmeta/bsp/drivers/media/platform/rtk_dprx/Kconfig
```kconfig
# SPDX-License-Identifier: GPL-2.0-only

comment "Realtek DisplayPort receiver driver"

config RTK_DP_RX
	tristate "RTK DP RX Support"
	select VIDEOBUF2_DMA_CONTIG
	help
	  This is a v4l2 driver for Realtek DisplayPort receiver interface.

	  To compile this driver as a module, choose M here. The module
	  will be called rtk_dprx.
```

## meta-xpressreal/recipes-kernel/linux/files-6.12/avengers-kmeta/bsp/drivers/soc/realtek/common/pcpu/Kconfig
```kconfig
config RTK_DDR_DFS
	tristate "Support DDR DFS control"
	default n
	help
	  DDR DFS is automatically controlled by the hardware and firmware.
	  However some parameters can be configured from kernel.

config RTK_DDR_DYNIF
	tristate "Support DDR dynamic calibration/refresh control"
	default n
	help
	  DDR dynamic calibration and refresh-rate update are controled by PCPU.
	  The sysfs can used to enable/disable the functions and change parameters.

config RTK_PCPU_DEVOPT
	tristate "Support PCPU developer options"
	default n

config RTK_NSB2_TRASH
	tristate "Support NSB2 trash"
	default n
	help
	  A new SB2 for FuSa can not be set and controlled from the kernel.
	  This driver provides a path for passing from the mailbox to the PCPU for
	  usage of developement debug.
```

## meta-xpressreal/recipes-kernel/linux/files-6.6/avengers-kmeta/bsp/drivers/gpu/drm/realtek/Kconfig
```kconfig
config DRM_VGA_RTK
	tristate "Realtek DRM VGA driver"
        depends on DRM
	depends on R8168
        help
          Choose this option if you have a Realtek NIC with dash function.
          This driver display to pcie vga device.

config DRM_RTK
	tristate "DRM Support for Realtek SoCs"
	depends on DRM
	select DRM_GEM_CMA_HELPER
	select DRM_KMS_HELPER
	select DRM_GEM_DMA_HELPER
	select DRM_DISPLAY_HELPER
	select DRM_DISPLAY_DP_HELPER
	select DRM_DISPLAY_HDCP_HELPER
	select DRM_DISPLAY_HDMI_HELPER
	select DRM_MIPI_DSI
	select VIDEOMODE_HELPERS
	select DRM_KMS_HELPER
	select DRM_GEM_DMA_HELPER if CHROME_PLATFORMS
	select DRM_DISPLAY_HELPER if CHROME_PLATFORMS
	select DRM_DISPLAY_DP_HELPER if CHROME_PLATFORMS
	select DRM_DISPLAY_HDCP_HELPER if CHROME_PLATFORMS
	select DRM_DISPLAY_HDMI_HELPER if CHROME_PLATFORMS
	select DRM_DP_CEC if CHROME_PLATFORMS
	select SND_SOC_HDMI_CODEC if CHROME_PLATFORMS && SND_SOC_RTK_HIFI_MACHINE
	help
	  Choose this option if you have a Realtek SoCs.
	  The module will be called realtek-drm
	  This driver provides kernel mode setting and
	  buffer management to userspace.

if DRM_RTK

config RTK_METADATA_AUTOJUDGE
	bool "Realtek specific METADATA buffer auto judgement"
	default n

config RTK_DRM_SPLASH_LOGO
	select LOGO
	select LOGO_LINUX_CLUT224
	bool "Realtek DRM Splash logo"
	default n

if CHROME_PLATFORMS

config RTK_DRM_CACHEABLE_HEADER
	bool "Realtek DRM Cacheable Header"
	default n

endif

endif
```
