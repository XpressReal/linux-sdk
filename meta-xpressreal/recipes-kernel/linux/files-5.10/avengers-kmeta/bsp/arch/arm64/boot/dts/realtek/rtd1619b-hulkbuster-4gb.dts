// SPDX-License-Identifier: (GPL-2.0-or-later OR BSD-2-Clause)
/*
 * Copyright (c) 2020-2024 Realtek Semiconductor Corp.
 */

/dts-v1/;

#include "rtd1619b-hulkbuster.dtsi"

/ {
	compatible = "realtek,hulkbuster", "realtek,rtd1619b";
	model = "Realtek Hulkbuster EVB (4GB)";

	memory@40000 {
		device_type = "memory";
		reg = <0x00040000 0x7ffc0000>,
		      <0x80020000 0x080e0000>,
		      <0x8a100000 0x0defc000>,
		      <0x98200000 0x00df0000>,
		      <0x99000000 0x07000000>,
		      <0xa0200000 0x5ee00000>;
	};
};
