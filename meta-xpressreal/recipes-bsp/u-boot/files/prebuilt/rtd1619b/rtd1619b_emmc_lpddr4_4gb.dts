// SPDX-License-Identifier: GPL-2.0+
/dts-v1/;
#include "rtd1619b_emmc.dtsi"

&binman {
	filename = "bind_4gb.bin";
};

&scs_param {
	filename = "scs_param/0000/SCS_Params_Area_RTD1619B_hwsetting_BOOT_LPDDR4_32Gb_ddp_s2666.ddr.bin";
};
