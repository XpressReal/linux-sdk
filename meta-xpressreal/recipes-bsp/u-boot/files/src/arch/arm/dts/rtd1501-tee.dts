/dts-v1/;
/plugin/;

#include "tee.dtsi"

/ {
	fragment@1 {
		target = <&reserved_memory>;

		__overlay__ {
			tee: optee@10040000 {
				reg = <0x10040000 0x02000000>; /* TEE: 32MB */
				no-map;
			};
		};
	};
};

